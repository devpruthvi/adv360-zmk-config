## Kconfig
```kconfig
config ADV360_STATUS_REPORT
    bool "Report layer, battery and output state to the host over raw HID"
    default y
    depends on ZMK_SPLIT_ROLE_CENTRAL
    select RAW_HID
    imply ZMK_SPLIT_BLE_CENTRAL_BATTERY_LEVEL_FETCHING

# Raw HID needs a second USB HID interface
config USB_HID_DEVICE_COUNT
    default 2 if ADV360_STATUS_REPORT
```

## config/west.yml
```yaml
manifest:
  remotes:
    - name: zmkfirmware
      url-base: https://github.com/zmkfirmware
    - name: urob
      url-base: https://github.com/urob
    - name: zzeneg
      url-base: https://github.com/zzeneg
  projects:
    - name: zmk
      remote: zmkfirmware
      revision: 5b51501fead672c41b5cfb396f3dafe0894bf4e9  # main
      import: app/west.yml
    - name: zmk-helpers
      remote: urob
      revision: 7bcba18fc8df27303eb92a435d33ea870cc51f98  # main
      path: modules/zmk/helpers
    - name: zmk-raw-hid
      remote: zzeneg
      revision: 6a37765dfab6197292e7a9f47305dcf87386d56a  # main
      path: modules/zmk/raw-hid
    - name: zephyr
      remote: zmkfirmware
      revision: 10ba6d0cb38bc3d258775d27982f707599320085  # v4.1.0+zmk-fixes
      import:
        name-blocklist:
          - ci-tools
          - hal_altera
          - hal_cypress
          - hal_infineon
          - hal_microchip
          - hal_nxp
          - hal_openisa
          - hal_silabs
          - hal_xtensa
          - hal_st
          - hal_ti
          - loramac-node
          - mcuboot
          - mcumgr
          - net-tools
          - openthread
          - edtt
          - trusted-firmware-m
  self:
    path: config
```
