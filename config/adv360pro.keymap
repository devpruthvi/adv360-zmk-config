// Kinesis Advantage 360 Pro keymap, ported from Miryoku ZMK.

// Mouse speeds, must precede pointing.h
#define ZMK_POINTING_DEFAULT_MOVE_VAL 1250
#define ZMK_POINTING_DEFAULT_SCRL_VAL 100

#include <behaviors.dtsi>
#include <dt-bindings/zmk/backlight.h>
#include <dt-bindings/zmk/bt.h>
#include <dt-bindings/zmk/ext_power.h>
#include <dt-bindings/zmk/keys.h>
#include <dt-bindings/zmk/outputs.h>
#include <dt-bindings/zmk/pointing.h>
#include <dt-bindings/zmk/rgb.h>

#include "zmk-helpers/helper.h"
#include "zmk-helpers/key-labels/adv360.h"

#define BASE 0
#define EXTRA 1
#define TAP 2
#define BUTTON 3
#define NAV 4
#define MOUSE 5
#define MEDIA 6
#define NUM 7
#define SYM 8
#define FUN 9

#define ___ &trans
#define XXX &none

// Places the 30 alpha keys and 6 thumb keys; everything else falls through to Base
#define ADV360_LAYER(...) ADV360_LAYER_(__VA_ARGS__)
#define ADV360_LAYER_( \
    K00, K01, K02, K03, K04, K05, K06, K07, K08, K09, \
    K10, K11, K12, K13, K14, K15, K16, K17, K18, K19, \
    K20, K21, K22, K23, K24, K25, K26, K27, K28, K29, \
    H0, H1, H2, H3, H4, H5) \
___ ___ ___ ___ ___ ___ ___                          ___ ___ ___ ___ ___ ___ ___ \
___ K00 K01 K02 K03 K04 ___                          ___ K05 K06 K07 K08 K09 ___ \
___ K10 K11 K12 K13 K14 ___     ___ ___  ___ ___     ___ K15 K16 K17 K18 K19 ___ \
___ K20 K21 K22 K23 K24             ___  ___             K25 K26 K27 K28 K29 ___ \
___ ___ ___ ___ ___             H0 H1 H2  H3 H4 H5           ___ ___ ___ ___ ___

// Clipboard (Miryoku default codes)
#define U_RDO &kp K_AGAIN
#define U_PST &kp LS(INS)
#define U_CPY &kp LC(INS)
#define U_CUT &kp LS(DEL)
#define U_UND &kp K_UNDO

#define U_TAPPING_TERM 200

// Timeless home-row mods: hold only resolves when a key on the other hand or a thumb follows
#define HRM_PROPS \
    flavor = "balanced"; \
    tapping-term-ms = <U_TAPPING_TERM>; \
    quick-tap-ms = <175>; \
    require-prior-idle-ms = <110>; \
    bindings = <&kp>, <&kp>; \
    hold-trigger-on-release;

ZMK_HOLD_TAP(hml, HRM_PROPS hold-trigger-key-positions = <KEYS_R THUMBS>;)
ZMK_HOLD_TAP(hmr, HRM_PROPS hold-trigger-key-positions = <KEYS_L THUMBS>;)

// Thumb layer-taps; quick-tap lets tap-then-hold repeat the key
ZMK_HOLD_TAP(u_lt,
    flavor = "tap-preferred";
    tapping-term-ms = <U_TAPPING_TERM>;
    quick-tap-ms = <200>;
    bindings = <&mo>, <&kp>;)

// Double-tap guards for layer switches and bootloader
#define DOUBLE_TAP(NAME, BINDING) \
    ZMK_TAP_DANCE(NAME, tapping-term-ms = <U_TAPPING_TERM>; bindings = <&none>, <BINDING>;)

DOUBLE_TAP(u_to_base, &to BASE)
DOUBLE_TAP(u_to_extra, &to EXTRA)
DOUBLE_TAP(u_to_tap, &to TAP)
DOUBLE_TAP(u_to_nav, &to NAV)
DOUBLE_TAP(u_to_mouse, &to MOUSE)
DOUBLE_TAP(u_to_media, &to MEDIA)
DOUBLE_TAP(u_to_num, &to NUM)
DOUBLE_TAP(u_to_sym, &to SYM)
DOUBLE_TAP(u_to_fun, &to FUN)
DOUBLE_TAP(u_boot, &bootloader)

// Shifted variants: Shift+select clears the BT profile, Shift+toggle forces USB, Shift+caps word is Caps Lock
#define SHIFT_MORPH(NAME, BINDING, SHIFTED) \
    ZMK_MOD_MORPH(NAME, bindings = <BINDING>, <SHIFTED>; mods = <(MOD_LSFT|MOD_RSFT)>;)
#define BT_SEL_CLR(N) \
    ZMK_MACRO(u_bt_clr_##N, wait-ms = <0>; bindings = <&bt BT_SEL N &bt BT_CLR>;) \
    SHIFT_MORPH(u_bt_sel_##N, &bt BT_SEL N, &u_bt_clr_##N)

BT_SEL_CLR(0)
BT_SEL_CLR(1)
BT_SEL_CLR(2)
BT_SEL_CLR(3)
SHIFT_MORPH(u_out_tog, &out OUT_TOG, &out OUT_USB)
SHIFT_MORPH(u_caps_word, &caps_word, &kp CAPS)

&mmv {
    acceleration-exponent = <1>;
    time-to-max-speed-ms = <1500>;
    delay-ms = <0>;
};

&msc {
    acceleration-exponent = <1>;
    time-to-max-speed-ms = <5000>;
    delay-ms = <0>;
};

#define THUMBS_BASE &u_lt NAV ESC &u_lt MEDIA BSPC &u_lt MOUSE TAB  &u_lt FUN DEL &u_lt NUM RET &u_lt SYM SPACE

ZMK_LAYER(base,
&kp EQUAL  &kp N1        &kp N2        &kp N3         &kp N4         &kp N5  XXX                                            XXX  &kp N6  &kp N7         &kp N8         &kp N9        &kp N0              &kp MINUS
&kp TAB    &kp Q         &kp W         &kp E          &kp R          &kp T   XXX                                            XXX  &kp Y   &kp U          &kp I          &kp O         &kp P               &kp BSLH
&kp ESC    &hml LGUI A   &hml LALT S   &hml LCTRL D   &hml LSHFT F   &kp G   XXX  &kp LCTRL &kp RCTRL  &kp LGUI &kp LALT  XXX  &kp H   &hmr LSHFT J   &hmr LCTRL K   &hmr LALT L   &hmr LGUI SEMI      &kp SQT
&kp LSHFT  &u_lt BUTTON Z &hml RALT X  &kp C          &kp V          &kp B                  &kp LALT   &kp RCTRL                   &kp N   &kp M          &kp COMMA      &hmr RALT DOT &u_lt BUTTON SLASH  &kp RSHFT
XXX        &kp GRAVE     &kp CAPS      &kp LEFT       &kp RIGHT            THUMBS_BASE                                                  &kp UP         &kp DOWN      &kp LBKT            &kp RBKT      XXX
)

ZMK_LAYER(extra, ADV360_LAYER(
&kp Q,              &kp W,              &kp F,              &kp P,              &kp B,              &kp J,              &kp L,              &kp U,              &kp Y,              &kp SQT,
&hml LGUI A,        &hml LALT R,        &hml LCTRL S,       &hml LSHFT T,       &kp G,              &kp M,              &hmr LSHFT N,       &hmr LCTRL E,       &hmr LALT I,        &hmr LGUI O,
&u_lt BUTTON Z,     &hml RALT X,       &kp C,              &kp D,              &kp V,              &kp K,              &kp H,              &kp COMMA,          &hmr RALT DOT,     &u_lt BUTTON SLASH,
&u_lt NAV ESC,      &u_lt MEDIA BSPC,   &u_lt MOUSE TAB,    &u_lt FUN DEL,      &u_lt NUM RET,      &u_lt SYM SPACE
))

ZMK_LAYER(tap, ADV360_LAYER(
&kp Q,     &kp W,     &kp E,     &kp R,     &kp T,     &kp Y,     &kp U,     &kp I,     &kp O,     &kp P,
&kp A,     &kp S,     &kp D,     &kp F,     &kp G,     &kp H,     &kp J,     &kp K,     &kp L,     &kp SEMI,
&kp Z,     &kp X,     &kp C,     &kp V,     &kp B,     &kp N,     &kp M,     &kp COMMA, &kp DOT,   &kp SLASH,
&kp ESC,   &kp BSPC,  &kp TAB,   &kp DEL,   &kp RET,   &kp SPACE
))

ZMK_LAYER(button, ADV360_LAYER(
U_UND,     U_CUT,     U_CPY,     U_PST,     U_RDO,     U_RDO,     U_PST,     U_CPY,     U_CUT,     U_UND,
&kp LGUI,  &kp LALT,  &kp LCTRL, &kp LSHFT, XXX,       XXX,       &kp LSHFT, &kp LCTRL, &kp LALT,  &kp LGUI,
U_UND,     U_CUT,     U_CPY,     U_PST,     U_RDO,     U_RDO,     U_PST,     U_CPY,     U_CUT,     U_UND,
&mkp MB3,  &mkp MB1,  &mkp MB2,  &mkp MB2,  &mkp MB1,  &mkp MB3
))

// No bootloader key here: it was too easy to hit by accident
ZMK_LAYER(nav, ADV360_LAYER(
XXX,          &u_to_tap,    &u_to_extra,  &u_to_base,   XXX,          U_RDO,        U_PST,        U_CPY,        U_CUT,        U_UND,
&kp LGUI,     &kp LALT,     &kp LCTRL,    &kp LSHFT,    XXX,          &kp LEFT,     &kp DOWN,     &kp UP,       &kp RIGHT,    &u_caps_word,
XXX,          &kp RALT,     &u_to_num,    &u_to_nav,    XXX,          &kp HOME,     &kp PG_DN,    &kp PG_UP,    &kp END,      &kp INS,
XXX,          XXX,          XXX,          &kp RET,      &kp BSPC,     &kp DEL
))

ZMK_LAYER(mouse, ADV360_LAYER(
&u_boot,         &u_to_tap,       &u_to_extra,     &u_to_base,      XXX,             U_RDO,           U_PST,           U_CPY,           U_CUT,           U_UND,
&kp LGUI,        &kp LALT,        &kp LCTRL,       &kp LSHFT,       XXX,             &mmv MOVE_LEFT,  &mmv MOVE_DOWN,  &mmv MOVE_UP,    &mmv MOVE_RIGHT, XXX,
XXX,             &kp RALT,        &u_to_sym,       &u_to_mouse,     XXX,             &msc SCRL_LEFT,  &msc SCRL_DOWN,  &msc SCRL_UP,    &msc SCRL_RIGHT, XXX,
XXX,             XXX,             XXX,             &mkp MB2,        &mkp MB1,        &mkp MB3
))

ZMK_LAYER(media, ADV360_LAYER(
&u_boot,           &u_to_tap,         &u_to_extra,       &u_to_base,        &studio_unlock,    &rgb_ug RGB_EFF,   &rgb_ug RGB_HUI,   &rgb_ug RGB_SAI,   &rgb_ug RGB_BRI,   &rgb_ug RGB_TOG,
&kp LGUI,          &kp LALT,          &kp LCTRL,         &kp LSHFT,         &bl BL_TOG,        &kp C_PREV,        &kp C_VOL_DN,      &kp C_VOL_UP,      &kp C_NEXT,        &ext_power EP_TOG,
&bl BL_DEC,        &kp RALT,          &u_to_fun,         &u_to_media,       &bl BL_INC,        &u_bt_sel_0,       &u_bt_sel_1,       &u_bt_sel_2,       &u_bt_sel_3,       &u_out_tog,
XXX,               XXX,               XXX,               &kp C_STOP,        &kp C_PP,          &kp C_MUTE
))

ZMK_LAYER(num, ADV360_LAYER(
&kp LBKT,    &kp N7,      &kp N8,      &kp N9,      &kp RBKT,    XXX,         &u_to_base,  &u_to_extra, &u_to_tap,   &u_boot,
&kp SEMI,    &kp N4,      &kp N5,      &kp N6,      &kp EQUAL,   XXX,         &kp LSHFT,   &kp LCTRL,   &kp LALT,    &kp LGUI,
&kp GRAVE,   &kp N1,      &kp N2,      &kp N3,      &kp BSLH,    XXX,         &u_to_num,   &u_to_nav,   &kp RALT,    XXX,
&kp DOT,     &kp N0,      &kp MINUS,   XXX,         XXX,         XXX
))

// No bootloader key here: it was too easy to hit by accident
ZMK_LAYER(sym, ADV360_LAYER(
&kp LBRC,    &kp AMPS,    &kp ASTRK,   &kp LPAR,    &kp RBRC,    XXX,         &u_to_base,  &u_to_extra, &u_to_tap,   XXX,
&kp COLON,   &kp DLLR,    &kp PRCNT,   &kp CARET,   &kp PLUS,    XXX,         &kp LSHFT,   &kp LCTRL,   &kp LALT,    &kp LGUI,
&kp TILDE,   &kp EXCL,    &kp AT,      &kp HASH,    &kp PIPE,    XXX,         &u_to_sym,   &u_to_mouse, &kp RALT,    XXX,
&kp LPAR,    &kp RPAR,    &kp UNDER,   XXX,         XXX,         XXX
))

ZMK_LAYER(fun, ADV360_LAYER(
&kp F12,         &kp F7,          &kp F8,          &kp F9,          &kp PSCRN,       XXX,             &u_to_base,      &u_to_extra,     &u_to_tap,       &u_boot,
&kp F11,         &kp F4,          &kp F5,          &kp F6,          &kp SLCK,        XXX,             &kp LSHFT,       &kp LCTRL,       &kp LALT,        &kp LGUI,
&kp F10,         &kp F1,          &kp F2,          &kp F3,          &kp PAUSE_BREAK, XXX,             &u_to_fun,       &u_to_media,     &kp RALT,        XXX,
&kp K_APP,       &kp SPACE,       &kp TAB,         XXX,             XXX,             XXX
))
